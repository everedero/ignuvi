## CMakeLists.txt
```
# SPDX-License-Identifier: Apache-2.0

cmake_minimum_required(VERSION 3.20.0)
find_package(Zephyr REQUIRED HINTS $ENV{ZEPHYR_BASE})
project(radio_scan)

target_sources(app PRIVATE src/main.c)
```

## sample.yaml
```
sample:
  name: SAMR21 radio scan
tests:
  ignuvi.radio_scan:
    build_only: true
    platform_allow:
      - ignuvi_radio
    tags: ieee802154
```

## prj.conf
```kconfig
# AT86RF233 bring-up: "ieee802154 scan active all 300" from the shell
CONFIG_NETWORKING=y
CONFIG_NET_L2_IEEE802154=y
CONFIG_NET_L2_IEEE802154_SHELL=y
CONFIG_NET_IPV6=n
CONFIG_NET_IPV4=n
CONFIG_NET_UDP=n
CONFIG_NET_TCP=n
CONFIG_LOG=y
# ponytail: SAMR21 has no TRNG driver; CSMA backoff only needs a non-crypto RNG.
# Seed from AT86RF233 RSSI noise (or a real entropy source) before any security use.
CONFIG_TEST_RANDOM_GENERATOR=y
```

## src/main.c
```c
/*
 * SPDX-License-Identifier: Apache-2.0
 *
 * Radio bring-up: everything happens in the ieee802154 shell.
 */

#include <zephyr/kernel.h>
#include <zephyr/logging/log.h>
#include <zephyr/net/net_if.h>

LOG_MODULE_REGISTER(radio_scan, LOG_LEVEL_INF);

int main(void)
{
	struct net_if *iface = net_if_get_ieee802154();

	if (iface == NULL) {
		LOG_ERR("no IEEE 802.15.4 interface");
		return -ENODEV;
	}

	LOG_INF("rf2xx up, try: ieee802154 scan active all 300");
	return 0;
}
```
