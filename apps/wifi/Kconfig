## apps/wifi/Kconfig
```kconfig
# SPDX-License-Identifier: Apache-2.0

config IGNUVI_WIFI_FW
	string "Wi-Fi firmware image, relative to the app"
	default "fw/43430a0-7.45.96.88.bin"

config IGNUVI_WIFI_NVRAM
	string "Wi-Fi NVRAM text, relative to the app"
	default "fw/nvram_ap6212.txt"

config IGNUVI_WIFI_SSID
	string "Network to join after the scan (empty: scan only)"
	default ""

config IGNUVI_WIFI_PSK
	string "WPA2 passphrase"
	default ""

source "Kconfig.zephyr"
```

## boards/native/ignuvi/board.yml
```yaml
board:
  extend: native_sim
  variants:
    - name: ignuvi
      qualifier: native
```

## boards/vendor/ignuvi/Kconfig.ignuvi
```kconfig
# SPDX-License-Identifier: Apache-2.0

config BOARD_IGNUVI
	select SOC_STM32F412RX
```

## boards/vendor/ignuvi/board.yml
```yaml
# SPDX-License-Identifier: Apache-2.0

board:
  name: ignuvi
  full_name: Ignuvi pilot-wire gateway
  vendor: vendor
  socs:
    - name: stm32f412rx
```

## boards/vendor/ignuvi_radio/Kconfig.ignuvi_radio
```kconfig
# SPDX-License-Identifier: Apache-2.0

config BOARD_IGNUVI_RADIO
	select SOC_SAMR21E18A
```

## boards/vendor/ignuvi_radio/board.yml
```yaml
# SPDX-License-Identifier: Apache-2.0

board:
  name: ignuvi_radio
  full_name: Ignuvi ATSAMR21E18A radio MCU
  vendor: vendor
  socs:
    - name: samr21e18a
```

## drivers/Kconfig
```kconfig
# SPDX-License-Identifier: Apache-2.0

menu "ignuvi drivers"
rsource "sdhc/Kconfig"
endmenu
```
